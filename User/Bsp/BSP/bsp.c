#include "bsp.h"

Input_time Input_dev;

extern uint8_t esp01s_RxData[64];
uint8_t c;
BSP_TypeDef _BSP;
UART1_TypeDef BSP_UART1;
SPI1_TypeDef BSP_SPI1;

/*
*********************************************************************************************************
*	函 数 名: bsp_Init
*	功能说明: BSP 层初始化
*	形    参: 无
*	返 回 值: 无
*   备    注:
*********************************************************************************************************
*/
void bsp_Init(void)
{
    systickConfigure();

    bsp_esp01s_Init();
    _BSP._UART1 = BSP_UART1;
}

/*
*********************************************************************************************************
*	函 数 名: Input_dev_choose
*	功能说明: 输入设备选择初始化
*	形    参: 无
*	返 回 值: 无
*   备    注:
*********************************************************************************************************
*/
void Input_dev_choose(void)
{
    Input_dev.Input_Choose1 = time_Input_Choose1;
    Input_dev.Input_Choose2 = time_Input_Choose2;
};

/*
*********************************************************************************************************
*	函 数 名: HAL_TIM_PeriodElapsedCallback
*	功能说明: 定时器周期中断回调
*	形    参: htim - 定时器句柄
*	返 回 值: 无
*   备    注:
*********************************************************************************************************
*/

void HAL_TIM_PeriodElapsedCallback(TIM_HandleTypeDef *htim)
{
    if (htim->Instance == TIM2) 
    {
        Input_dev.Input_Choose1();
    }
}

/*
*********************************************************************************************************
*	函 数 名: HAL_TIM_IC_CaptureCallback
*	功能说明: 定时器输入捕获回调
*	形    参: htim - 定时器句柄
*	返 回 值: 无
*   备    注:
*********************************************************************************************************
*/
void HAL_TIM_IC_CaptureCallback(TIM_HandleTypeDef *htim)
{
    if (htim->Instance == TIM2) 
    {
        Input_dev.Input_Choose2();
    }
}

/*************************************************************************************************************************************************************
 *   函 数 名: HAL_UART_RxCpltCallback
 *   功能说明: UART 接收完成回调函数
 *   形    参: huart - 串口句柄
 *   返 回 值: 无
 ************************************************************************************************************************************************************/
/*
*********************************************************************************************************
*	函 数 名: HAL_UART_RxCpltCallback
*	功能说明: UART 接收完成回调
*	形    参: huart - 串口句柄
*	返 回 值: 无
*   备    注:
*********************************************************************************************************
*/
void HAL_UART_RxCpltCallback(UART_HandleTypeDef *huart)
{
    if (huart == &huart1)
    {
        _BSP._UART1.UART1_RxReceive();
    }
    if (huart == &huart2)
    {
        _BSP._UART2.UART1_RxReceive();
    }
}

/*
*********************************************************************************************************
*	函 数 名: HAL_SPI_TxRxCpltCallback
*	功能说明: SPI 收发完成回调
*	形    参: hspi - SPI句柄
*	返 回 值: 无
*   备    注:
*********************************************************************************************************
*/
uint8_t reLen = 0;                  
uint8_t nrf24l01RxBuffer[32] = {0}; 
void HAL_SPI_TxRxCpltCallback(SPI_HandleTypeDef *hspi)
{
    reLen = NRF24L01_RxPacket(nrf24l01RxBuffer);
}
