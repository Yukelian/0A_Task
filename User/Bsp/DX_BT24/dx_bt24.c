#include "dx_bt24.h"

uint8_t dxbt24_RxData[64];
uint8_t bt24_char;

/*
*********************************************************************************************************
*	函 数 名: 
*	功能说明: 
*	形    参: 
*	返 回 值: 
*   备    注：
*********************************************************************************************************
*/
void bsp_dx_bt24_Init(void)
{
    // BSP_UART1 = ESP_01S;
    BSP_UART1.UART1_RxReceive = dx_bt24_RxData;
    BSP_UART1.UART1_TxSend = dx_bt24_TxData;
    HAL_UART_Receive_DMA(&huart1, &bt24_char, 1);
}
/*
*********************************************************************************************************
*	函 数 名: 
*	功能说明: 
*	形    参: 
*	返 回 值: 
*   备    注：
*********************************************************************************************************
*/

HAL_StatusTypeDef dx_bt24_Init(void)
{

    return HAL_OK;
}

/*
*********************************************************************************************************
*	函 数 名: 
*	功能说明: 
*	形    参: 
*	返 回 值: 
*   备    注：
*********************************************************************************************************
*/
void dx_bt24_TxData(uint8_t *_DataBuf, uint32_t _Len)
{
    HAL_UART_Transmit_DMA(&huart1, _DataBuf, _Len);
}

/*
*********************************************************************************************************
*	函 数 名: 
*	功能说明: 
*	形    参: 
*	返 回 值: 
*   备    注：
*********************************************************************************************************
*/
void dx_bt24_RxData(void)
{
    static uint8_t i = 0;
    if (bt24_char != '\n')
    {
        dxbt24_RxData[i] = bt24_char;
        i++;
    }
    else
    {
        ParsingDxbt24Msg_test(dxbt24_RxData, i);
        i = 0;
    }
    HAL_UART_Receive_DMA(&huart1, &bt24_char, 1);
}

/*
*********************************************************************************************************
*	函 数 名: 
*	功能说明: 
*	形    参: 
*	返 回 值: 
*   备    注：
*********************************************************************************************************
*/
#define bt24_cmd data[0]
void ParsingDxbt24Msg_test(uint8_t *data, uint32_t lenth)
{
    if (bt24_cmd == '1')
    {
        dx_bt24_TxData("111", 3);
    }
    else if (bt24_cmd == '2')
    {
        dx_bt24_TxData("222", 3);
    }
    else if (bt24_cmd == '3')
    {
        dx_bt24_TxData("333", 3);
    }
}